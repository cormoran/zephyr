## dts/bindings/serial/nordic,nrf-uarte-half-duplex.yaml
```yaml
description: Nordic nRF UARTE Half-Duplex UART

compatible: "nordic,nrf-uarte-half-duplex"

include: ["nordic,nrf-uart-common.yaml", "memory-region.yaml"]

properties:
  switching-delay-us:
    description: Time in microseconds to wait after RX before starting TX.
    type: int
    default: 100
```

## dts/bindings/serial/nordic,nrf-uarte.yaml
```yaml
description: Nordic nRF family UARTE (UART with EasyDMA)

compatible: "nordic,nrf-uarte"

include: ["nordic,nrf-uart-common.yaml", "memory-region.yaml"]

properties:
  endtx-stoptx-supported:
    type: boolean
    description: |
      UARTE has ENDTX_STOPTX HW short.

  frame-timeout-supported:
    type: boolean
    description: |
      UARTE has RX frame timeout HW feature.

  half-duplex:
    type: boolean
    description: >
      Specifies whether the UARTE instance is configured for half-duplex operation.
      In half-duplex mode, the same physical line is used for both transmission and reception,
      but not simultaneously. **This feature is implemented on software and TX collision may damage
      the controller.** Application is responsible to avoid TX collision and the circuit should
      implement protection from TX collision for unexpected situations.
```
